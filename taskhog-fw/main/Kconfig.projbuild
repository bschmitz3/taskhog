## taskhog-fw/main/Kconfig.projbuild
```kconfig
menu "Taskhog"

    config TASKHOG_WIFI_SSID
        string "Wi-Fi SSID (M3: rede fixa)"
        default ""
        help
            SSID da rede usada para sincronizar com o Hub. Vazio = sync desligado
            (o device continua gravando offline normalmente).

    config TASKHOG_WIFI_PASSWORD
        string "Wi-Fi password"
        default ""
        help
            Senha WPA2. Vazio = rede aberta.

    config TASKHOG_HUB_URL
        string "Hub base URL"
        default "https://hub.taskhog.win"
        help
            Base do Hub (sem barra final). Ex.: https://hub.taskhog.win ou
            http://192.168.100.227:8088.

    config TASKHOG_DEVICE_TOKEN
        string "Device bearer token"
        default ""
        help
            Token enviado em Authorization: Bearer. Deve casar com device_tokens
            no hub.yaml.

    config TASKHOG_SYNC_MAX_ATTEMPTS
        int "Máx. tentativas de upload antes de marcar erro"
        default 5
        range 1 50

    config TASKHOG_DEEP_SLEEP_ENABLE
        bool "Enable deep sleep (portable / battery mode)"
        default n
        help
            Quando ativo, o device entra em deep sleep após ficar IDLE.
            Deixe desligado para desenvolvimento via USB com monitor serial.

    config TASKHOG_DEEP_SLEEP_SKIP_ON_USB
        bool "Skip auto sleep while USB is connected"
        default y
        depends on TASKHOG_DEEP_SLEEP_ENABLE

    config TASKHOG_DEEP_SLEEP_IDLE_SEC
        int "Seconds in IDLE before deep sleep"
        default 15
        range 3 300
        depends on TASKHOG_DEEP_SLEEP_ENABLE

    config TASKHOG_DEEP_SLEEP_TIMER_MIN
        int "Internal timer wake interval (minutes)"
        default 60
        range 1 1440
        depends on TASKHOG_DEEP_SLEEP_ENABLE

endmenu
```

## taskhog-fw/sdkconfig.defaults
```kconfig
# Target: ESP32-S3-PICO-1-N8R8 (8 MB flash, 8 MB OPI PSRAM)
CONFIG_IDF_TARGET="esp32s3"

# Flash
CONFIG_ESPTOOLPY_FLASHSIZE_8MB=y

# PSRAM octal (OPI)
CONFIG_SPIRAM=y
CONFIG_SPIRAM_MODE_OCT=y
CONFIG_SPIRAM_SPEED_80M=y
CONFIG_SPIRAM_USE_MALLOC=y

# USB Serial/JTAG console (Waveshare USB-C)
CONFIG_ESP_CONSOLE_USB_CDC=y

# Custom partition table (OTA A/B)
CONFIG_PARTITION_TABLE_CUSTOM=y
CONFIG_PARTITION_TABLE_CUSTOM_FILENAME="partitions.csv"
CONFIG_PARTITION_TABLE_FILENAME="partitions.csv"

# FreeRTOS
CONFIG_FREERTOS_HZ=1000

# Log
CONFIG_LOG_DEFAULT_LEVEL_INFO=y

# VFS — headroom para SD + console USB
CONFIG_VFS_MAX_COUNT=16

# TLS — bundle de CAs para HTTPS do Hub (Cloudflare) — M3
CONFIG_MBEDTLS_CERTIFICATE_BUNDLE=y
CONFIG_MBEDTLS_CERTIFICATE_BUNDLE_DEFAULT_FULL=y

# AES por polling (não interrupção): as fontes de interrupção do S3 já estão
# esgotadas (I2S áudio + SPI e-paper/SD + GPIOs + Wi-Fi). Com interrupção, o
# handshake WPA2 (aes_unwrap no EAPOL) aborta com "No free interrupt inputs for
# AES interrupt". Polling evita a alocação de IRQ. — M3
CONFIG_MBEDTLS_AES_USE_INTERRUPT=n

# MPI/RSA por polling: mesmo pool de IRQ esgotado; TLS (verificação de cert
# Cloudflare no Hub) aborta com "No free interrupt inputs for RSA interrupt".
CONFIG_MBEDTLS_MPI_USE_INTERRUPT=n
```
